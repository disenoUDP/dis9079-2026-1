#include <Wire.h>
#include <Adafruit_GFX.h>
#include <Adafruit_SSD1306.h>
#include "AdafruitIO_WiFi.h"


#define WIFI_SSID    "XXX"
#define WIFI_PASS    "XXX"
#define IO_USERNAME  "XXX"
#define IO_KEY       "XXX"


#define SCREEN_WIDTH   128
#define SCREEN_HEIGHT  64
#define SCREEN_ADDRESS 0x3C


Adafruit_SSD1306 display(SCREEN_WIDTH, SCREEN_HEIGHT, &Wire, -1);
AdafruitIO_WiFi io(IO_USERNAME, IO_KEY, WIFI_SSID, WIFI_PASS);


AdafruitIO_Feed *cerebro = io.feed("cerebro");


const char* respuestas[11] = {
 "",
 "La respuesta existe, pero esta ocupada",
 "No insista, siguiente pregunta",
 "No se, pero seria chistoso",
 "El sabio esta comiendo, vuelve pronto",
 "Jijiji",
 "Si se, pero no te voy a decir",
 "Cuestionable",
 "No puedo hablar, solo whatsapp",
 "Complicadito",
 "MIAU",
};


const unsigned char epd_bitmap_frames_01[] PROGMEM = {
0xff, 0xff, 0xff, 0xff, 0xff, 0xff, 0xff, 0xff, 0xff, 0xff, 0xff, 0xff, 0xff, 0xff, 0xff, 0xff,
0xff, 0xff, 0xff, 0xff, 0xff, 0xff, 0xff, 0xff, 0xff, 0xff, 0xff, 0xff, 0xff, 0xff, 0xff, 0xff,
0xff, 0xff, 0xff, 0xff, 0xff, 0xff, 0xff, 0xff, 0xff, 0xff, 0xff, 0xff, 0xff, 0xff, 0xff, 0xff,
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0xff, 0xff, 0xff, 0xff, 0xff, 0xff, 0xff, 0xff, 0xff, 0xff, 0xff, 0xff, 0xff, 0xff, 0xff, 0xff
};


const unsigned char epd_bitmap_frames_02[] PROGMEM = {
0xff, 0xff, 0xff, 0xff, 0xff, 0xff, 0xff, 0xff, 0xff, 0xff, 0xff, 0xff, 0xff, 0xff, 0xff, 0xff,
0xff, 0xff, 0xff, 0xff, 0xff, 0xff, 0xff, 0xff, 0xff, 0xff, 0xff, 0xff, 0xff, 0xff, 0xff, 0xff,
0xff, 0xff, 0xff, 0xff, 0xff, 0xff, 0xff, 0xff, 0xff, 0xff, 0xff, 0xff, 0xff, 0xff, 0xff, 0xff,
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0xff, 0xff, 0xff, 0xff, 0xff, 0xff, 0xff, 0xff, 0xff, 0xff, 0xff, 0xff, 0xff, 0xff, 0xff, 0xff
};


const unsigned char epd_bitmap_frames_03[] PROGMEM = {
0xff, 0xff, 0xff, 0xff, 0xff, 0xff, 0xff, 0xff, 0xff, 0xff, 0xff, 0xff, 0xff, 0xff, 0xff, 0xff,
0xff, 0xff, 0xff, 0xff, 0xff, 0xff, 0xfe, 0x3f, 0xff, 0xff, 0xff, 0xff, 0xff, 0xff, 0xff, 0xff,
0xff, 0xff, 0xff, 0xff, 0xff, 0xff, 0xff, 0xdf, 0xff, 0xff, 0xff, 0xff, 0xff, 0xff, 0xff, 0xff,
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0xff, 0xff, 0xff, 0xff, 0xff, 0xff, 0xff, 0xff, 0xff, 0xff, 0xff, 0xff, 0xff, 0xff, 0xff, 0xff
};


const unsigned char* frames[] = {
 epd_bitmap_frames_01,
 epd_bitmap_frames_02,
 epd_bitmap_frames_03
};
const int TOTAL_FRAMES = 3;


// --- VARIABLES GLOBALES ---
bool mostrandoTexto       = false;
unsigned long inicioTexto = 0;
const unsigned long TIEMPO_TEXTO = 5000;


unsigned long ultimoFrame = 0;
int frameActual           = 0;


int respuestaActual       = 1;
int ultimoValorRecibido   = -1;


// --- CALLBACK ---
void handleMessage(AdafruitIO_Data *data) {
 int numero = data->toInt();


 // Ignorar si es el mismo valor
 if (numero == ultimoValorRecibido) return;
 ultimoValorRecibido = numero;


 // 0 -> respuesta 10, 1-9 -> respuestas 1-9
 respuestaActual = (numero == 0) ? 10 : numero;


 Serial.print("Dato recibido: ");
 Serial.println(numero);
 Serial.print("Respuesta: ");
 Serial.println(respuestas[respuestaActual]);


 // Mostrar texto inmediatamente
 display.clearDisplay();
 display.setTextSize(1);
 display.setTextColor(SSD1306_WHITE);
 display.setCursor(0, 10);
 display.setTextWrap(true);
 display.println(respuestas[respuestaActual]);
 display.display();


 mostrandoTexto = true;
 inicioTexto    = millis();
}


// --- SETUP ---
void setup() {
 Serial.begin(115200);


 if (!display.begin(SSD1306_SWITCHCAPVCC, SCREEN_ADDRESS)) {
   Serial.println(F("Error: pantalla SSD1306 no encontrada"));
   while (true);
 }


 display.clearDisplay();
 display.display();


 cerebro->onMessage(handleMessage);


 Serial.println("Conectando a Adafruit IO...");
 io.connect();
 while (io.status() < AIO_CONNECTED) {
   Serial.print(".");
   delay(500);
 }
 Serial.println();
 Serial.println("Conectado a Adafruit IO");
}


// --- LOOP ---
void loop() {
 io.run();


 // Volver al GIF después de 5 segundos
 if (mostrandoTexto && millis() - inicioTexto >= TIEMPO_TEXTO) {
   mostrandoTexto = false;
   Serial.println("Volviendo al GIF");
 }


 // GIF o texto
 if (!mostrandoTexto) {
   if (millis() - ultimoFrame >= 120) {
     ultimoFrame = millis();
     display.clearDisplay();
     display.drawBitmap(0, 0, frames[frameActual], SCREEN_WIDTH, SCREEN_HEIGHT, SSD1306_WHITE);
     display.display();
     frameActual = (frameActual + 1) % TOTAL_FRAMES;
   }
 }
}

